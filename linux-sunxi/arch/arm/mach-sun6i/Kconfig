## linux-sunxi/arch/arm/mach-sun6i/Kconfig
```kconfig
choice
	prompt "Allwinner Platform Type"
	depends on ARCH_SUN6I || ARCH_SUN7I
	default AW_PLATFORM_EVB

config AW_FPGA_V4_PLATFORM
       bool "FPGAv4 board"
       help
         Support for Allwinner's FPGAv4 board

config AW_FPGA_V7_PLATFORM
       bool "FPGAv7 board"
       help
         Support for Allwinner's FPGAv4 board

config AW_ASIC_EVB_PLATFORM
       bool "EVB board"
       help
         Support for Allwinner's EVB board

endchoice

config SUNXI_SYSFS
	bool "Allwinner SUNXI Sysfs"
    depends on ARCH_SUN6I
	help
	  Support /sys/class/sunxi for kernel.

config SUNXI_POWER_SCENE
	bool "support scene change notify"
	depends on SUNXI_SYSFS
	help
	  Support /sys/class/sunxi/power/scene for kernel.

config SUNXI_DRAM
	bool "support dram paras changed dynamically"
	depends on SUNXI_SYSFS
	help
	  Support /sys/class/sunxi/dram for kernel.

config SUNXI_MEMORY_SIZE
	int "Memory Size(in MB) on sunxi Platform"
	default 2048
	depends on ARCH_SUN6I
	help
	Memory Size(in MB) on sunxi Platform

config SUNXI_MEMORY_RESERVED_SIZE_1G
	int "reserved Memory size(in MB) for sunxi 1G/2G deve heap."
	default 110
	depends on ARCH_SUN6I
	help
	  Select reserved memory size for sunxi 1G/2G deve heap, the memory is used by deve.
	  Examples:
	  100 => reserve 100M bytes memory for deve heap.
	  230 => reserve 230M bytes memory for deve heap.

config SUNXI_MEMORY_RESERVED_SIZE_512M
	int "reserved Memory size(in MB) for sunxi 512M deve heap."
	default 78
	depends on ARCH_SUN6I
	help
	  Select reserved memory size for sunxi 512M deve heap, the memory is used by deve.
	  Examples:
	  100 => reserve 100M bytes memory for deve heap.
	  230 => reserve 230M bytes memory for deve heap.
```

## linux-sunxi/drivers/char/ar100_test/Kconfig
```kconfig
#
# sun4i ar100 test configuration.
#

menuconfig SUN6I_AR100_TEST
	tristate "sun6i ar100 test drivers"
	---help---
	  This module is to test ar100 module, which builted in lichee kernel,
	  source is in "arch\arm\mach-sun6i\ar100" directory.

if SUN6I_AR100_TEST

config AR100_TEST_DRIVER
	tristate "sun6i ar100 test driver"
	default m
	help
	  Nothing help.

endif # SUN6I_AR100_TEST
```

## linux-sunxi/drivers/char/dma_test/Kconfig
```kconfig
#
# sun46 dma test configuration.
#
config DMA_TEST_DRIVER
	tristate "sun6i dma test driver"
	default m
	help
	Nothing help.
```

## linux-sunxi/drivers/char/gpio_test/Kconfig
```kconfig
#
# sun6i gpio test configuration.
#
config GPIO_TEST_DRIVER
	tristate "sun6i gpio test driver"
	default m
	help
	Nothing help.
```

## linux-sunxi/drivers/char/sun6i_g2d/Kconfig
```kconfig
config SUN6I_G2D
	depends on ARCH_SUN6I
	tristate "SUN6I G2D"
	default y
#	depends on HAS_IOMEM
	help
```

## linux-sunxi/drivers/char/sunxi_mem_test/Kconfig
```kconfig
#
# sunxi continous physic memory test.
#

config SUNXI_MEM_TEST
	tristate "sunxi continous physic memory allocator test driver"
	default m
	depends on SUNXI_PHYS_MEM_ALLOCATOR
	help
	Nothing help.
```

## linux-sunxi/drivers/gpu/Kconfig
```kconfig
menu "gpu"

source "drivers/gpu/ion/Kconfig"
source "drivers/gpu/drm/Kconfig"
source "drivers/gpu/stub/Kconfig"
source "drivers/gpu/vga/Kconfig"

endmenu
```

## linux-sunxi/drivers/gpu/ion/Kconfig
```kconfig
menuconfig ION
	tristate "Ion Memory Manager"
	select GENERIC_ALLOCATOR
	select DMA_SHARED_BUFFER
	help
	  Chose this option to enable the ION Memory Manager.

config ION_CARVEOUT
	bool "Carveout heap"
	depends on ARM
	help
	  Enable physical memory carveout and chunk heaps. Only supported on
	  ARM platforms.

config ION_SUNXI_CARVEOUT_SIZE_1G
	int "memory size(in MB) for sunxi carveout ion heap of 1G/2G devices."
	default 32
	depends on ION
	help
	  Select memory size for sunxi carveout ion heap, the memory is used by modules that need physical continous memory, such as gpu and ve...
	  Examples:
	  	     100 => reserve 100M bytes memory for carveout heap.
	  	     230 => reserve 230M bytes memory for carveout heap.

config ION_SUNXI_CARVEOUT_SIZE_512M
    int "memory size(in MB) for sunxi carveout ion heap of 512M devices."
       default 26
       depends on ION_SUNXI
       help
         Select memory size for sunxi carveout ion heap, the memory is used by modules that need physical continous memory, such as gpu and ve...
         Examples:
               100 => reserve 100M bytes memory for carveout heap.
               230 => reserve 230M bytes memory for carveout heap.

config ION_SUNXI
	tristate "Enable sunxi ion support"
	default y
	depends on ION && ARCH_SUN6I
	help
	  Enabling this will register the sunxi SYSTEM and CARVEOUT heaps with ion.
```

## linux-sunxi/drivers/input/ls/Kconfig
```kconfig
#
# Input light_sensor drivers configuration
#
menuconfig INPUT_LIGHT_SENSOR
	bool "light_sensor"
	default y
	help
	  Say Y here, and a list of supported light_sensor will be displayed.
	  This option doesn't affect the kernel.

	  If unsure, say Y.

if INPUT_LIGHT_SENSOR
config INPUT_LTR501ALS
	tristate "LTR501ALS LIGHT SENSOR driver"
	depends on I2C
	default m
	help
	  Say Y here if you want to use LTR501ALS
	  through I2C interface.

	  To compile this driver as a module, choose M here: the
	  module will be called ltr501als.
endif
```

## linux-sunxi/drivers/media/video/sun6i/Kconfig
```kconfig
config VIDEO_DECODER_SUN6I
	tristate "sun6i video decoder support"
	depends on VIDEO_SUN6I_CEDAR
	default y
	---help---
	  This is the driver for sun4i video decoder, including h264/
	  mpeg4/mpeg2/vc1/rmvb. 
	  To compile this driver as a module, choose M here: the
	  module will be called cedar_dev.
```

## linux-sunxi/drivers/media/video/sunxi-vfe/Kconfig
```kconfig
config CSI_VFE
	tristate "CSI1 v4l2 driver for SUNXI"
	default m
	select VIDEOBUF_DMA_CONTIG
	
```

## linux-sunxi/drivers/net/wireless/bcmdhd/Kconfig
```kconfig
config BCMDHD
	tristate "Broadcom 4329/30 wireless cards support"
	depends on MMC
	default n
	---help---
	  This module adds support for wireless adapters based on
	  Broadcom 4329/30 chipset.

config BCMDHD_WEXT
	bool "Enable WEXT support"
	depends on BCMDHD && CFG80211 = n
	select WIRELESS_EXT
	select WEXT_PRIV
	help
	  Enables WEXT support

choice
    depends on BCMDHD
    prompt "Interrupt type"
config BCMDHD_OOB
	depends on BCMDHD
	bool "Out-of-Band Interrupt"
	default y
	---help---
		Interrupt through WL_HOST_WAKE.
config BCMDHD_SDIO_IRQ
	depends on  BCMDHD
	bool "In-Band Interrupt"
	---help---
		Interrupt through SDIO DAT[1]
endchoice

config BCMDHD_OOB_LOW_LEVEL_TRIGGER
	depends on BCMDHD_OOB
	bool "Low level trigger for OOB interrupt"
	default n
	---help---
	  This macro is needed while an inverter between wl_host_wake pin and cpu.
	  Please check PCB to confirm whether define this macro, default is no.
```

## linux-sunxi/drivers/net/wireless/rtl8723as/Kconfig
```kconfig
config RTL8723AS
	tristate "Realtek 8723A SDIO WiFi"
	select WIRELESS_EXT
	select WEXT_PRIV	
	---help---
	  Help message of RTL8723AS
```

## linux-sunxi/drivers/power/axp_power/Kconfig
```kconfig
menuconfig AW_AXP
	bool "AXP Power drivers"
	depends on REGULATOR
	default n
	---help---
	  This option allows you to select AXP power driver

if AW_AXP

choice
	prompt "AXP PMU type"
	default AW_AXP22

config AW_AXP22
	bool "AXP22 driver"
	---help---
	  AXP22 driver

endchoice

config AXP_CHARGEINIT
	bool "AXP initial charging environment set"
	default y

config AXP_CHGCHANGE
	bool "AXP charging current set when suspend\resume\shutdown"
	default y

config AXP_TWI_USED
	bool "AXP use twi as transfer channel"
	default n
	
endif # !AW_AXP
```

## linux-sunxi/drivers/test/Kconfig
```kconfig
#
# sunxi dailibuild test configuration.
#
# NOTE: this macro define the kernel release version for dailibuild-test or for normal.
#

config SUNXI_TEST_SELECT
	bool "sunxi test select"
	default y
	help
	  This macro define the kernel release version for dailibuild-test or for normal.
	  If you need build/release kernel version for dailibuild-test, please select it, otherwise
	  please donot select.


# for nand test
# source "drivers/test/nand/Kconfig"
```

## linux-sunxi/drivers/video/sun6i/tv/Kconfig
```kconfig
#config TV_DEV_SEL
#	tristate
	
config TV_GM7121
	tristate "GM7121 driver for SUNXI"
	default m
	---help---
```

## linux-sunxi/sound/soc/sun6i/hdmiaudio/Kconfig
```kconfig
config SND_SUN6I_SOC_HDMIAUDIO
	tristate "HDMI Audio for the ReuuiMlla SUN6I chips"
	default n
	help
	  Say Y or M if you want to add support for hdmi audio
```

## linux-sunxi/sound/soc/sun6i/i2s/Kconfig
```kconfig
config SND_SUN6I_SOC_I2S_INTERFACE
	tristate "SoC i2s interface for the ReuuiMlla SUN6I chips"
	default n
	help
	  Say Y or M if you want to add support for codecs attached to
	  the SUN6I AC97, I2S or PCM interface. You will also need
	  to select the audio interfaces to support below.
```

## linux-sunxi/sound/soc/sun6i/pcm/Kconfig
```kconfig
config SND_SUN6I_SOC_PCM_INTERFACE
	tristate "SoC pcm interface for the ReuuiMlla SUN6I chips"
	default n
	help
	  Say Y or M if you want to add support for codecs attached to
	  the SUN6I AC97, I2S or PCM interface. You will also need
	  to select the audio interfaces to support below.
```
